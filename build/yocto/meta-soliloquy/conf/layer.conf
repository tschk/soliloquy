## build/yocto/meta-soliloquy/conf/layer.conf
```bitbake
# We have a conf and classes directory, add to BBPATH
BBPATH .= ":${LAYERDIR}"

# We have recipes-* directories, add to BBFILES
BBFILES += "${LAYERDIR}/recipes-*/*/*.bb \
            ${LAYERDIR}/recipes-*/*/*.bbappend"

BBFILE_COLLECTIONS += "meta-soliloquy"
BBFILE_PATTERN_meta-soliloquy = "^${LAYERDIR}/"
BBFILE_PRIORITY_meta-soliloquy = "6"

LAYERDEPENDS_meta-soliloquy = "core"
LAYERSERIES_COMPAT_meta-soliloquy = "kirkstone langdale mickledore nanbield scarthgap"
```
